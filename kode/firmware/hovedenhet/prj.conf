## CMakeLists.txt
```
# Bygg med nRF Connect SDK (Zephyr), f.eks.:
#   west build -b nrf9151dk/nrf9151/ns
cmake_minimum_required(VERSION 3.20.0)
find_package(Zephyr REQUIRED HINTS $ENV{ZEPHYR_BASE})
project(gvt_hovedenhet)

target_sources(app PRIVATE
  src/main.c
  src/alarm_logic.c
  src/heartbeat.c
  src/channels.c
  src/protocol.c
  src/geofence.c
  # src/hal_nrf.c   # lages av leverandør: modem, GNSS, LoRa, sensorbuss, ATECC608B
  src/hal_stub.c    # midlertidig, fjernes når hal_nrf.c finnes
)
```

## prj.conf
```kconfig
# Utgangspunkt for nRF9151. Leverandøren fullfører.
CONFIG_NEWLIB_LIBC=y
CONFIG_MAIN_STACK_SIZE=4096
CONFIG_LOG=y

# Modem: LTE-M og NB-IoT, NTN når tilgjengelig i SDK
CONFIG_NRF_MODEM_LIB=y
CONFIG_LTE_LINK_CONTROL=y
CONFIG_LTE_NETWORK_MODE_LTE_M_NBIOT=y

# Oppdateringer (kapittel om programvare og oppdateringer)
CONFIG_BOOTLOADER_MCUBOOT=y
CONFIG_IMG_MANAGER=y
CONFIG_FOTA_DOWNLOAD=y
CONFIG_DFU_TARGET=y

# Sikker kommunikasjon
CONFIG_NET_SOCKETS=y
CONFIG_MODEM_KEY_MGMT=y

# I2C for ATECC608B, IMU, lyssensor; SPI for CAN-kontroller og LoRa
CONFIG_I2C=y
CONFIG_SPI=y
CONFIG_GPIO=y
```

## src/main.c
```c
/* GPS Vs Tyv – hovedenhet, fastvareskjelett (første versjon).
 * Hovedløkke: les sensorer -> vurder etter miljøprofil -> send alarm eller heartbeat på beste kanal.
 * Ikke testet på maskinvare. Strømsparing (hendelsesstyrt søvn), FOTA, LoRa-mesh og sensorbuss
 * implementeres av leverandøren etter designdokumentet. */
#include "alarm_logic.h"
#include "channels.h"
#include "heartbeat.h"
#include "protocol.h"
#include "hal.h"

#ifndef GVT_DEVICE_ID
#define GVT_DEVICE_ID "GVT-0001A" /* skrives inn ved produksjon */
#endif

static gvt_env_t env = ENV_LANDLIG;   /* settes fra plattformen ved oppsett */
static uint8_t tamper_seen;
static const char *ch_name[] = { "LTE-M", "NTN", "LoRa", "lokal" };

static void transmit(gvt_msg_t *m, bool is_alarm)
{
	gvt_radio_t r; hal_read_radio(&r);
	gvt_channel_t ch = gvt_choose_channel(&r, is_alarm);
	m->ch = ch_name[ch]; m->rsrp = r.rsrp_dbm; m->noise = gvt_jamming_suspected(&r); m->gnss_jam = r.gnss_jam;
	uint8_t buf[640], ack[128]; size_t al = sizeof ack;
	size_t n = gvt_seal(m, hal_sign, buf, sizeof buf);
	if (!n) return;
	if (ch == CH_STORE || hal_send(ch, buf, n, ack, &al) != 0) hal_store(buf, n);
	/* TODO leverandør: verifiser kvittering med plattformens offentlige nøkkel og hent nytt intervall. */
}

static gvt_msg_t base(const char *type, uint16_t iv, bool armed)
{
	gvt_msg_t m = { 0 };
	m.id = GVT_DEVICE_ID; m.ctr = hal_counter_next(); m.ts = hal_time_s(); m.type = type; m.iv = iv;
	m.bat = hal_battery_pct(); m.ext = hal_ext_power(); m.tamper = hal_tamper_bits(); m.armed = armed;
	return m;
}

int main(void)
{
	hal_init();
	gvt_hb_state_t hb = { .mode = HB_ARMED };
	uint32_t until_hb_ms = 0, elapsed_ms = 0;
	for (;;) {
		gvt_inputs_t in; hal_read_inputs(&in);
		uint8_t t = hal_tamper_bits();
		in.tamper_new = t & (uint8_t)~tamper_seen; tamper_seen = t;
		hb.ext_power = hal_ext_power(); hb.battery_pct = hal_battery_pct();

		gvt_result_t res = gvt_evaluate(env, &in);
		/* Modus følger beslutningen (alarm > mistenkelig > armert/avarmert), med holdetid. */
		bool changed = gvt_hb_update_mode(&hb, in.armed, res.decision, elapsed_ms);
		uint16_t iv = gvt_hb_interval(&hb);
		/* Tettere oppfølging skal gjelde med en gang, ikke først etter det gamle intervallet. */
		if (changed && until_hb_ms > (uint32_t)iv * 1000u) until_hb_ms = gvt_hb_next_ms(iv, hal_random32());
		if (res.decision == DEC_ALARM || res.decision == DEC_INFO) {
			gvt_msg_t m = base(res.decision == DEC_ALARM ? "alarm" : "info", iv, in.armed);
			m.ev_code = in.tamper_new ? "TA" : (res.decision == DEC_ALARM ? "BA" : "OP");
			m.ev_zone = (uint8_t)in.zone; m.ev_text = res.reason; m.ev_img = res.send_image;
			transmit(&m, res.decision == DEC_ALARM);
			if (res.siren) hal_siren(true, res.siren_s);
		}
		if (until_hb_ms == 0) {
			gvt_msg_t m = base("hb", iv, in.armed);
			transmit(&m, false);
			until_hb_ms = gvt_hb_next_ms(iv, hal_random32());
		}
		/* I drift: sov til neste heartbeat eller til en sensor vekker enheten (avbrudd). */
		uint32_t step = until_hb_ms < 1000 ? until_hb_ms : 1000;
		hal_sleep_ms(step); until_hb_ms -= step; elapsed_ms = step;
#ifdef GVT_HOST_ONCE
		break;
#endif
	}
	return 0;
}
```

## src/alarm_logic.c
```c
#include "alarm_logic.h"

unsigned gvt_popcount8(uint8_t v) { unsigned n = 0; while (v) { n += v & 1u; v >>= 1; } return n; }

static gvt_result_t mk(gvt_decision_t d, bool siren, uint16_t siren_s, bool img, const char *why)
{
	gvt_result_t r = { d, siren, siren_s, img, why };
	return r;
}

gvt_result_t gvt_evaluate(gvt_env_t env, const gvt_inputs_t *in)
{
	/* 1. Entydig sabotasje gir alltid alarm, også avarmert og i læremodus. */
	if (in->tamper_new) {
		return mk(DEC_ALARM, in->armed, env == ENV_BY ? 60 : 0, true, "Sabotasje");
	}
	if (!in->armed) return mk(DEC_NONE, false, 0, false, "");

	/* 2. Fysiske tegn, renset for det som rammer alle (lastebil, tog) og vær. */
	uint8_t signs = in->signs;
	if (in->neighbors_same_vibration >= 2) signs &= (uint8_t)~SIGN_VIBRATION;
	if (in->weather_damp) signs &= (uint8_t)~SIGN_VIBRATION;
	unsigned nsigns = gvt_popcount8(signs);

	bool person = in->radar_person || in->camera_person;
	if (in->weather_damp && !in->camera_person) person = false; /* radar alene stoles ikke på i uvær */
	bool confirmed = in->radar_person && in->camera_person;

	/* 3. Krav for alarm per miljøprofil */
	bool alarm = false, doubt = false;
	if (in->zone == ZONE_CORE && person) {
		switch (env) {
		case ENV_SKOG:
			alarm = confirmed || in->dwell_on_machine_s > 10 || nsigns >= 1;
			doubt = !alarm;
			break;
		case ENV_LANDLIG:
			alarm = nsigns >= 1;
			doubt = !alarm;
			break;
		case ENV_BY:
			alarm = nsigns >= 2;
			doubt = !alarm && (nsigns == 1 || in->dwell_on_machine_s > 30);
			break;
		}
	} else if (in->zone != ZONE_CORE && (signs & (SIGN_CAN_ACTIVE | SIGN_TILT_LIFT | SIGN_DOOR))) {
		/* Ingen person sett, men maskinen startes, løftes eller åpnes: tvil, bilde til anleggsleder. */
		doubt = true;
	}

	if (in->learning) {
		/* Læremodus: logger hva som ville skjedd, men alarmerer ikke. */
		return mk((alarm || doubt) ? DEC_LOG : DEC_NONE, false, 0, false, alarm ? "Læremodus: ville gitt alarm" : "Læremodus");
	}
	if (alarm) return mk(DEC_ALARM, true, env == ENV_BY ? 60 : 0, true, "Person i kjernesonen og fysiske tegn");
	if (doubt) return mk(DEC_INFO, false, 0, true, "Usikker hendelse, bilde til anleggsleder");

	/* 4. Ytre sone gir aldri alarm alene */
	if (person && in->zone == ZONE_OUTER) {
		switch (env) {
		case ENV_SKOG: return mk(DEC_INFO, false, 0, true, "Person i ytre sone");
		case ENV_LANDLIG: return in->night ? mk(DEC_INFO, false, 0, true, "Person i ytre sone om natten") : mk(DEC_LOG, false, 0, false, "Person i ytre sone");
		case ENV_BY: return mk(DEC_LOG, false, 0, false, "Person i ytre sone");
		}
	}
	return mk(DEC_NONE, false, 0, false, "");
}
```

## src/alarm_logic.h
```c
/* Alarmlogikk med miljøprofiler (kapittel 8 i designdokumentet).
 * Ren C uten avhengigheter, slik at den kan testes på PC. */
#ifndef GVT_ALARM_LOGIC_H
#define GVT_ALARM_LOGIC_H
#include <stdbool.h>
#include <stdint.h>

typedef enum { ENV_SKOG = 0, ENV_LANDLIG = 1, ENV_BY = 2 } gvt_env_t;
typedef enum { ZONE_NONE = 0, ZONE_OUTER = 1, ZONE_CORE = 2 } gvt_zone_t;
typedef enum { DEC_NONE = 0, DEC_LOG = 1, DEC_INFO = 2, DEC_ALARM = 3 } gvt_decision_t;

/* Fysiske tegn: noen gjør noe med maskinen */
enum {
	SIGN_VIBRATION = 1u << 0, /* IMU */
	SIGN_TOOL_SOUND = 1u << 1, /* mikrofon: vinkelsliper, bormaskin */
	SIGN_DOOR = 1u << 2,       /* kabindør / lokk på verktøykasse */
	SIGN_CAN_ACTIVE = 1u << 3, /* tenning eller CAN-trafikk uten avarmering */
	SIGN_TILT_LIFT = 1u << 4,  /* helning eller løft */
};

/* Entydig sabotasje: samme bitverdier som TAMPER i shared/protocol.ts */
enum {
	TAMPER_LID = 1u << 0, TAMPER_MESH = 1u << 1, TAMPER_ANTENNA = 1u << 2, TAMPER_GPS_LOOP = 1u << 3,
	TAMPER_POWER = 1u << 4, TAMPER_CAMERA = 1u << 5, TAMPER_CAN_GPS = 1u << 6,
};

typedef struct {
	gvt_zone_t zone;          /* hvor radaren ser personen */
	bool radar_person;        /* radaren klassifiserer person (ikke dyr) */
	bool camera_person;       /* kameraets KI bekrefter person */
	uint16_t dwell_on_machine_s; /* hvor lenge personen har vært på maskinen */
	uint8_t signs;            /* SIGN_* */
	uint8_t tamper_new;       /* nye TAMPER_*-bit siden forrige vurdering */
	uint8_t neighbors_same_vibration; /* antall naboer som melder samme vibrasjon samtidig */
	bool weather_damp;        /* sterk vind, regn eller snø fra værdata */
	bool night;               /* lokal natt etter anleggets kalender */
	bool learning;            /* læremodus de første 1–2 ukene */
	bool armed;
} gvt_inputs_t;

typedef struct {
	gvt_decision_t decision;
	bool siren;
	uint16_t siren_s;         /* 0 = til kvittering */
	bool send_image;
	const char *reason;       /* kort forklaring, sendes som tekst i meldingen */
} gvt_result_t;

gvt_result_t gvt_evaluate(gvt_env_t env, const gvt_inputs_t *in);
unsigned gvt_popcount8(uint8_t v);

#endif
```

## src/channels.c
```c
#include "channels.h"

gvt_channel_t gvt_choose_channel(const gvt_radio_t *r, bool is_alarm)
{
	if (r->lte_registered && r->rsrp_dbm > -125) return CH_LTE;
	/* Satellitt er dyrt og tregt: brukes for alarmer, og for heartbeat bare når LoRa heller ikke finnes. */
	if (r->ntn_available && (is_alarm || r->lora_neighbors == 0)) return CH_NTN;
	if (r->lora_neighbors > 0) return CH_LORA;
	if (r->ntn_available) return CH_NTN;
	return CH_STORE;
}

bool gvt_jamming_suspected(const gvt_radio_t *r)
{
	if (r->gnss_jam || r->gnss_spoof) return true;
	bool normally_good = r->rsrp_learned_dbm > -110;
	bool lost = !r->lte_registered || r->rsrp_dbm < r->rsrp_learned_dbm - 20;
	return normally_good && lost && r->lte_noise_high;
}
```

## src/channels.h
```c
/* Kanalvalg og jammingdeteksjon. Rekkefølge: LTE-M -> NTN (satellitt) -> LoRa via nabo -> lagre og sende senere. */
#ifndef GVT_CHANNELS_H
#define GVT_CHANNELS_H
#include <stdbool.h>
#include <stdint.h>

typedef enum { CH_LTE = 0, CH_NTN = 1, CH_LORA = 2, CH_STORE = 3 } gvt_channel_t;

typedef struct {
	bool lte_registered;
	int16_t rsrp_dbm;         /* signalstyrke */
	int16_t rsrp_learned_dbm; /* normalnivå lært i læremodus */
	bool lte_noise_high;      /* modemet melder høy støy / tap av synk */
	bool ntn_available;       /* satellitt i sikt og abonnement aktivt */
	uint8_t lora_neighbors;   /* naboer hørt siste 5 min */
	bool gnss_jam;            /* MAX-M10S melder jamming */
	bool gnss_spoof;
} gvt_radio_t;

gvt_channel_t gvt_choose_channel(const gvt_radio_t *r, bool is_alarm);
/* Jamming: brudd i et ellers stabilt mønster, sammen med støy. Dårlig dekning alene er ikke jamming. */
bool gvt_jamming_suspected(const gvt_radio_t *r);

#endif
```

## src/geofence.c
```c
#include "geofence.h"
#include <math.h>

#define DEG2RAD 0.017453292519943295f
#define EARTH_R 6371000.0f

static void to_xy(const gvt_pt_t *ref, int32_t lat, int32_t lon, float *x, float *y)
{
	float lat0 = (float)ref->lat_e7 * 1e-7f;
	*x = (float)(lon - ref->lon_e7) * 1e-7f * DEG2RAD * EARTH_R * cosf(lat0 * DEG2RAD);
	*y = (float)(lat - ref->lat_e7) * 1e-7f * DEG2RAD * EARTH_R;
}

static float seg_dist(float px, float py, float ax, float ay, float bx, float by)
{
	float dx = bx - ax, dy = by - ay, l2 = dx * dx + dy * dy, t = 0.0f;
	if (l2 > 0.0f) { t = ((px - ax) * dx + (py - ay) * dy) / l2; t = t < 0.0f ? 0.0f : (t > 1.0f ? 1.0f : t); }
	float ex = px - (ax + t * dx), ey = py - (ay + t * dy);
	return sqrtf(ex * ex + ey * ey);
}

float gvt_fence_distance(const gvt_fence_t *f, int32_t lat_e7, int32_t lon_e7)
{
	if (f->n < 3) return 0.0f;
	float px, py, d = 1e30f; int inside = 0;
	to_xy(&f->pts[0], lat_e7, lon_e7, &px, &py);
	for (uint8_t i = 0, j = f->n - 1; i < f->n; j = i++) {
		float xi, yi, xj, yj;
		to_xy(&f->pts[0], f->pts[i].lat_e7, f->pts[i].lon_e7, &xi, &yi);
		to_xy(&f->pts[0], f->pts[j].lat_e7, f->pts[j].lon_e7, &xj, &yj);
		if (((yi > py) != (yj > py)) && (px < (xj - xi) * (py - yi) / (yj - yi) + xi)) inside = !inside;
		float s = seg_dist(px, py, xi, yi, xj, yj);
		if (s < d) d = s;
	}
	return inside ? -d : d;
}

int gvt_fence_outside(const gvt_fence_t *f, int32_t lat_e7, int32_t lon_e7, uint16_t acc_m)
{
	return gvt_fence_distance(f, lat_e7, lon_e7) - (float)acc_m > (float)f->buffer_m;
}
```

## src/geofence.h
```c
/* Geofence i enheten: lagret kopi av anleggets gjerde, slik at enheten selv merker
 * at den forlater anlegget også når mobilnettet er jammet (meldes da via LoRa eller satellitt). */
#ifndef GVT_GEOFENCE_H
#define GVT_GEOFENCE_H
#include <stdint.h>

#define GVT_FENCE_MAX_PTS 32

typedef struct { int32_t lat_e7, lon_e7; } gvt_pt_t;
typedef struct { gvt_pt_t pts[GVT_FENCE_MAX_PTS]; uint8_t n; uint16_t buffer_m; } gvt_fence_t;

/* Avstand i meter fra punktet til gjerdet: negativ innenfor, positiv utenfor. */
float gvt_fence_distance(const gvt_fence_t *f, int32_t lat_e7, int32_t lon_e7);
/* 1 = sikkert ute (avstand minus unøyaktighet er større enn bufferen), 0 ellers. */
int gvt_fence_outside(const gvt_fence_t *f, int32_t lat_e7, int32_t lon_e7, uint16_t acc_m);

#endif
```

## src/hal.h
```c
/* Maskinvarelag. Hovedenheten implementerer dette mot Zephyr/nRF Connect SDK (hal_nrf.c, lages av leverandør).
 * hal_stub.c brukes på PC og i tester. */
#ifndef GVT_HAL_H
#define GVT_HAL_H
#include <stdbool.h>
#include <stddef.h>
#include <stdint.h>
#include "alarm_logic.h"
#include "channels.h"

int hal_init(void);
uint32_t hal_time_s(void);              /* UTC fra nettet eller GNSS */
uint32_t hal_random32(void);            /* ATECC608B eller nRF CRACEN */
uint32_t hal_counter_next(void);        /* monoton teller i ATECC608B (overlever omstart) */
int hal_sign(const uint8_t *data, size_t len, uint8_t sig[64]); /* ATECC608B slot 0 */

void hal_read_inputs(gvt_inputs_t *in); /* radar, kamera via sensorbuss, IMU, mikrofon, CAN, tamper */
void hal_read_radio(gvt_radio_t *r);
uint8_t hal_battery_pct(void);
bool hal_ext_power(void);
uint8_t hal_tamper_bits(void);

int hal_send(gvt_channel_t ch, const uint8_t *data, size_t len, uint8_t *ack, size_t *ack_len); /* 0 = sendt og kvittert */
int hal_store(const uint8_t *data, size_t len); /* kø i ekstern flash til dekning er tilbake */
void hal_siren(bool on, uint16_t seconds);
void hal_sleep_ms(uint32_t ms);
#endif
```

## src/hal_stub.c
```c
/* Stubber for PC-bygg og tester. Ingen ekte maskinvare. */
#include "hal.h"
#include <stdio.h>
#include <string.h>
#include <time.h>

static uint32_t ctr;
int hal_init(void) { return 0; }
uint32_t hal_time_s(void) { return (uint32_t)time(NULL); }
uint32_t hal_random32(void) { static uint32_t x = 2463534242u; x ^= x << 13; x ^= x >> 17; x ^= x << 5; return x; }
uint32_t hal_counter_next(void) { return ++ctr; }
int hal_sign(const uint8_t *data, size_t len, uint8_t sig[64]) { (void)data; (void)len; memset(sig, 0xA5, 64); return 0; } /* IKKE en ekte signatur */
void hal_read_inputs(gvt_inputs_t *in) { memset(in, 0, sizeof *in); in->armed = true; }
void hal_read_radio(gvt_radio_t *r) { memset(r, 0, sizeof *r); r->lte_registered = true; r->rsrp_dbm = -95; r->rsrp_learned_dbm = -95; r->lora_neighbors = 3; }
uint8_t hal_battery_pct(void) { return 96; }
bool hal_ext_power(void) { return true; }
uint8_t hal_tamper_bits(void) { return 0; }
int hal_send(gvt_channel_t ch, const uint8_t *d, size_t n, uint8_t *ack, size_t *al) { (void)d; (void)ack; *al = 0; printf("[stub] sender %zu byte på kanal %d\n", n, ch); return 0; }
int hal_store(const uint8_t *d, size_t n) { (void)d; printf("[stub] lagrer %zu byte\n", n); return 0; }
void hal_siren(bool on, uint16_t s) { printf("[stub] sirene %s %u s\n", on ? "på" : "av", s); }
void hal_sleep_ms(uint32_t ms) { (void)ms; }
```

## src/heartbeat.c
```c
#include "heartbeat.h"

uint16_t gvt_hb_interval(const gvt_hb_state_t *s)
{
	uint16_t iv;
	switch (s->mode) {
	case HB_ALARM: iv = 15; break;      /* tett oppfølging under alarm */
	case HB_SUSPICIOUS: iv = 30; break;
	case HB_DISARMED: iv = 900; break;  /* i arbeidstid holder det med sjeldne livstegn */
	case HB_ARMED: default: iv = 120; break;
	}
	/* På reservebatteri: spar strøm, men aldri lenger enn 10 min når armert. */
	if (!s->ext_power && s->mode == HB_ARMED) iv = s->battery_pct < 20 ? 600 : 300;
	if (s->platform_override_s >= 15 && s->platform_override_s <= 3600 && s->mode != HB_ALARM) iv = s->platform_override_s;
	return iv;
}

uint32_t gvt_hb_next_ms(uint16_t interval_s, uint32_t random32)
{
	uint32_t full = (uint32_t)interval_s * 1000u;
	uint32_t jitter = full / 10u;
	return full - (jitter ? random32 % jitter : 0);
}

static uint32_t count_down(uint32_t left, uint32_t elapsed) { return left > elapsed ? left - elapsed : 0; }

bool gvt_hb_update_mode(gvt_hb_state_t *s, bool armed, gvt_decision_t decision, uint32_t elapsed_ms)
{
	gvt_hb_mode_t before = s->mode;
	s->alarm_left_ms = count_down(s->alarm_left_ms, elapsed_ms);
	s->susp_left_ms = count_down(s->susp_left_ms, elapsed_ms);
	if (decision == DEC_ALARM) s->alarm_left_ms = GVT_HB_ALARM_HOLD_MS;
	else if (decision == DEC_INFO) s->susp_left_ms = GVT_HB_SUSP_HOLD_MS;
	if (s->alarm_left_ms) s->mode = HB_ALARM;
	else if (s->susp_left_ms) s->mode = HB_SUSPICIOUS;
	else s->mode = armed ? HB_ARMED : HB_DISARMED;
	return s->mode != before;
}
```

## src/heartbeat.h
```c
/* Heartbeat-intervall og jitter (kapittel om mottakssentral og heartbeat). */
#ifndef GVT_HEARTBEAT_H
#define GVT_HEARTBEAT_H
#include <stdbool.h>
#include <stdint.h>
#include "alarm_logic.h"

typedef enum { HB_ARMED = 0, HB_DISARMED = 1, HB_SUSPICIOUS = 2, HB_ALARM = 3 } gvt_hb_mode_t;

typedef struct {
	gvt_hb_mode_t mode;
	bool ext_power;       /* maskinens batteri tilkoplet */
	uint8_t battery_pct;  /* reservebatteri */
	uint16_t platform_override_s; /* 0 = ingen, ellers intervall plattformen har bedt om i kvitteringen */
	uint32_t alarm_left_ms;  /* holdetid for alarmmodus etter siste alarmbeslutning */
	uint32_t susp_left_ms;   /* holdetid for mistenkelig-modus etter siste info-beslutning */
} gvt_hb_state_t;

#define GVT_HB_ALARM_HOLD_MS 600000u /* 10 min med tett heartbeat etter siste alarm */
#define GVT_HB_SUSP_HOLD_MS  120000u /* 2 min etter siste mistenkelige hendelse */

/* Setter modus ut fra armering og siste beslutning fra alarmlogikken.
 * Alarm går foran mistenkelig, som går foran armert/avarmert. Holdetiden telles ned med elapsed_ms,
 * slik at modusen ikke faller tilbake i neste runde selv om beslutningen bare kom én gang.
 * Returnerer true når modusen endret seg (da bør neste heartbeat planlegges på nytt). */
bool gvt_hb_update_mode(gvt_hb_state_t *s, bool armed, gvt_decision_t decision, uint32_t elapsed_ms);

uint16_t gvt_hb_interval(const gvt_hb_state_t *s);
/* Neste sendetid: intervall minus 0–10 % tilfeldig, slik at enhetene ikke sender samtidig og aldri for sent. */
uint32_t gvt_hb_next_ms(uint16_t interval_s, uint32_t random32);

#endif
```

## src/protocol.c
```c
#include "protocol.h"
#include <string.h>

void cbor_init(cbor_w *w, uint8_t *buf, size_t cap) { w->buf = buf; w->cap = cap; w->len = 0; w->err = false; }

static void put(cbor_w *w, uint8_t b) { if (w->len < w->cap) w->buf[w->len++] = b; else w->err = true; }

static void head(cbor_w *w, uint8_t major, uint64_t n)
{
	uint8_t m = (uint8_t)(major << 5);
	if (n < 24) put(w, m | (uint8_t)n);
	else if (n <= 0xff) { put(w, m | 24); put(w, (uint8_t)n); }
	else if (n <= 0xffff) { put(w, m | 25); put(w, (uint8_t)(n >> 8)); put(w, (uint8_t)n); }
	else if (n <= 0xffffffffu) { put(w, m | 26); for (int s = 24; s >= 0; s -= 8) put(w, (uint8_t)(n >> s)); }
	else { put(w, m | 27); for (int s = 56; s >= 0; s -= 8) put(w, (uint8_t)(n >> s)); }
}

void cbor_uint(cbor_w *w, uint64_t v) { head(w, 0, v); }
void cbor_int(cbor_w *w, int64_t v) { if (v >= 0) head(w, 0, (uint64_t)v); else head(w, 1, (uint64_t)(-1 - v)); }
void cbor_text(cbor_w *w, const char *s) { size_t n = strlen(s); head(w, 3, n); for (size_t i = 0; i < n; i++) put(w, (uint8_t)s[i]); }
void cbor_bytes(cbor_w *w, const uint8_t *b, size_t n) { head(w, 2, n); for (size_t i = 0; i < n; i++) put(w, b[i]); }
void cbor_bool(cbor_w *w, bool v) { put(w, v ? 0xf5 : 0xf4); }
void cbor_array(cbor_w *w, size_t n) { head(w, 4, n); }
void cbor_map(cbor_w *w, size_t n) { head(w, 5, n); }

size_t gvt_encode_payload(const gvt_msg_t *m, uint8_t *out, size_t cap)
{
	cbor_w w; cbor_init(&w, out, cap);
	bool has_ev = m->ev_code != NULL, has_tgt = m->tgt != NULL;
	size_t n = 6 /* v id ctr ts type iv */ + 2 /* st rf */ + (has_ev ? 1 : 0) + (has_tgt ? 1 : 0) + (m->has_pos ? 1 : 0);
	cbor_map(&w, n);
	cbor_uint(&w, F_V); cbor_uint(&w, GVT_PROTOCOL_VERSION);
	cbor_uint(&w, F_ID); cbor_text(&w, m->id);
	cbor_uint(&w, F_CTR); cbor_uint(&w, m->ctr);
	cbor_uint(&w, F_TS); cbor_uint(&w, m->ts);
	cbor_uint(&w, F_TYPE); cbor_text(&w, m->type);
	cbor_uint(&w, F_IV); cbor_uint(&w, m->iv);

	cbor_uint(&w, F_ST); cbor_map(&w, 4);
	cbor_uint(&w, ST_BAT); cbor_uint(&w, m->bat);
	cbor_uint(&w, ST_EXT); cbor_bool(&w, m->ext);
	cbor_uint(&w, ST_TAMPER); cbor_uint(&w, m->tamper);
	cbor_uint(&w, ST_ARMED); cbor_bool(&w, m->armed);

	cbor_uint(&w, F_RF); cbor_map(&w, 4);
	cbor_uint(&w, RF_CH); cbor_text(&w, m->ch ? m->ch : "LTE-M");
	cbor_uint(&w, RF_RSRP); cbor_int(&w, m->rsrp);
	cbor_uint(&w, RF_NOISE); cbor_bool(&w, m->noise);
	cbor_uint(&w, RF_GNSSJAM); cbor_bool(&w, m->gnss_jam);

	if (has_ev) {
		size_t k = 1 + (m->ev_zone ? 1 : 0) + (m->ev_text ? 1 : 0) + (m->ev_img ? 1 : 0);
		cbor_uint(&w, F_EV); cbor_map(&w, k);
		cbor_uint(&w, EV_CODE); cbor_text(&w, m->ev_code);
		if (m->ev_zone) { cbor_uint(&w, EV_ZONE); cbor_uint(&w, m->ev_zone); }
		if (m->ev_text) { cbor_uint(&w, EV_TEXT); cbor_text(&w, m->ev_text); }
		if (m->ev_img) { cbor_uint(&w, EV_IMG); cbor_bool(&w, true); }
	}
	if (has_tgt) { cbor_uint(&w, F_TGT); cbor_text(&w, m->tgt); }
	if (m->has_pos) { cbor_uint(&w, F_POS); cbor_array(&w, 3); cbor_int(&w, m->lat_e7); cbor_int(&w, m->lon_e7); cbor_uint(&w, m->acc_m); }
	return w.err ? 0 : w.len;
}

size_t gvt_seal(const gvt_msg_t *m, gvt_sign_fn sign, uint8_t *out, size_t cap)
{
	uint8_t payload[512], sig[64];
	size_t n = gvt_encode_payload(m, payload, sizeof payload);
	if (!n || sign(payload, n, sig) != 0) return 0;
	cbor_w w; cbor_init(&w, out, cap);
	cbor_array(&w, 2); cbor_bytes(&w, payload, n); cbor_bytes(&w, sig, 64);
	return w.err ? 0 : w.len;
}
```

## src/protocol.h
```c
/* Meldingsformat v1, samme feltnummer som shared/protocol.ts.
 * Konvolutt: CBOR-liste [payload: bytes, signatur: bytes(64)], ECDSA P-256 r||s fra ATECC608B. */
#ifndef GVT_PROTOCOL_H
#define GVT_PROTOCOL_H
#include <stdbool.h>
#include <stddef.h>
#include <stdint.h>

#define GVT_PROTOCOL_VERSION 1

enum { F_V = 1, F_ID = 2, F_CTR = 3, F_TS = 4, F_TYPE = 5, F_IV = 6, F_ST = 7, F_RF = 8, F_EV = 9, F_TGT = 10, F_ENV = 11, F_POS = 12 };
enum { ST_BAT = 1, ST_VINMV = 2, ST_TEMPC = 3, ST_EXT = 4, ST_TAMPER = 5, ST_ARMED = 6 };
enum { RF_CH = 1, RF_RSRP = 2, RF_NOISE = 3, RF_GNSSJAM = 4 };
enum { EV_CODE = 1, EV_ZONE = 2, EV_TEXT = 3, EV_IMG = 4 };

typedef struct { uint8_t *buf; size_t cap, len; bool err; } cbor_w;

void cbor_init(cbor_w *w, uint8_t *buf, size_t cap);
void cbor_uint(cbor_w *w, uint64_t v);
void cbor_int(cbor_w *w, int64_t v);
void cbor_text(cbor_w *w, const char *s);
void cbor_bytes(cbor_w *w, const uint8_t *b, size_t n);
void cbor_bool(cbor_w *w, bool v);
void cbor_array(cbor_w *w, size_t n);
void cbor_map(cbor_w *w, size_t n);

typedef struct {
	const char *id;
	uint32_t ctr;
	uint32_t ts;
	const char *type;   /* "hb", "alarm", "info", "report" */
	uint16_t iv;
	/* status */
	uint8_t bat; bool ext; uint8_t tamper; bool armed;
	/* radio */
	const char *ch; int16_t rsrp; bool noise; bool gnss_jam;
	/* hendelse (valgfri) */
	const char *ev_code; uint8_t ev_zone; const char *ev_text; bool ev_img;
	const char *tgt;    /* for "report" */
	/* posisjon (valgfri): grader × 1e7 og nøyaktighet i meter */
	bool has_pos; int32_t lat_e7; int32_t lon_e7; uint16_t acc_m;
} gvt_msg_t;

/* Koder payload. Returnerer lengde, 0 ved feil. Nøkler i stigende rekkefølge (deterministisk). */
size_t gvt_encode_payload(const gvt_msg_t *m, uint8_t *out, size_t cap);

/* Signeringsfunksjon: ATECC608B i drift, programvare i tester. 0 = OK. */
typedef int (*gvt_sign_fn)(const uint8_t *data, size_t len, uint8_t sig[64]);

/* Lager signert konvolutt. Returnerer lengde, 0 ved feil. */
size_t gvt_seal(const gvt_msg_t *m, gvt_sign_fn sign, uint8_t *out, size_t cap);

#endif
```
